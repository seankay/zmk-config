/*
 * Copyright (c) 2020 The ZMK Contributors
 *
 * SPDX-License-Identifier: MIT
 */

#include <behaviors.dtsi>
#include <dt-bindings/zmk/keys.h>
#include <dt-bindings/zmk/bt.h>
#define CONFIG_WIRELESS
#define ZMK_LAYER_WITH_OUTER(name, LT, RT, LM, RM, LB, RB, LH, RH, LO, RO)      \
    ZMK_LAYER(                                                                   \
        name,                                                                    \
                 LT RT                                                           \
                 LM RM                                                           \
                 LB RB                                                           \
        LO LH RH RO                                                              \
    )

#define ZMK_BASE_LAYER(name, LT, RT, LM, RM, LB, RB, LH, RH)                   \
    ZMK_LAYER_WITH_OUTER(name, LT, RT, LM, RM, LB, RB, LH, RH, &trans, &trans)

#define ZMK_DEF_LAYER(name, LT, RT, LM, RM, LB, RB, LH, RH)                    \
    ZMK_LAYER_WITH_OUTER(name, LT, RT, LM, RM, LB, RB, LH, RH, &kp LGUI, &kp LALT)

#include "zmk-helpers/key-labels/42.h"
#include "base.keymap"

/{ chosen { zmk,physical-layout = &foostan_corne_6col_layout; }; };
